## conf/distro/davy.conf
```bitbake
require conf/distro/poky.conf
DISTRO = "davy"
DISTRO_NAME = "Fangyan Davy Linux"
DISTRO_VERSION = "1.0"
SDK_VENDOR = "-davysdk"
SDK_VERSION := "${@'${DISTRO_VERSION}'.replace('snapshot-${DATE}','snapshot')}"
MAINTAINER = "Hominlinx Yuan<yg@shfangyan.cn>"

TARGET_VENDOR = "-davy"

INHERIT += "rm_work"

VIRTUAL-RUNTIME_dev_manager = ""
VIRTUAL-RUNTIME_keymaps = ""

DISTRO_FEATURES += "alsa"
DISTRO_FEATURES_remove = "3g irda nfc pci pcmcia x11 nfs"
DISTRO_FEATURES_remove += "zeroconf pulseaudio directfb wayland"
```

## conf/layer.conf
```bitbake
# We have a conf and classes directory, add to BBPATH
BBPATH .= ":${LAYERDIR}"

# We have recipes-* directories, add to BBFILES
BBFILES += "${LAYERDIR}/recipes-*/*/*.bb \
    ${LAYERDIR}/recipes-*/*/*.bbappend"

BBFILE_COLLECTIONS += "fangyan"
BBFILE_PATTERN_fangyan = "^${LAYERDIR}/"
BBFILE_PRIORITY_fangyan = "13"
LAYERVERSION_fangyan = "3"

LAYERDEPENDS_fangyan = "core qt5-fangyan"
```
